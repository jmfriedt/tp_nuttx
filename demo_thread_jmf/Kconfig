## demo_thread_jmf/Kconfig
```kconfig
#
# For a description of the syntax of this configuration file,
# see the file kconfig-language.txt in the NuttX tools repository.
#

config APP_THREADJMF
	bool "\"Thread demo (JMF)"
	default n
	---help---
		Enable the thread demo application

if APP_THREADJMF

config APP_THREADJMD_PROGNAME
	string "Program name"
	default "threadjmf"
	depends on BUILD_KERNEL
	---help---
		This is the name of the program that will be use when the NSH ELF
		program is installed.

config APP_THREADJMF_PRIORITY
	int "thread demo task priority"
	default 100

config APP_THREADJMF_STACKSIZE
	int "thread demo stack size"
	default 2048

endif
```

## network/Kconfig
```kconfig
#
# For a description of the syntax of this configuration file,
# see the file kconfig-language.txt in the NuttX tools repository.
#

config APP_NETWORK
	bool "\"Network analyzer"
	default n
	---help---
		Enable the network analyzer application

if APP_NETWORK

config APP_NETWORK_PROGNAME
	string "Program name"
	default "network"
	depends on BUILD_KERNEL
	---help---
		This is the name of the program that will be use when the NSH ELF
		program is installed.

config APP_NETWORK_PRIORITY
	int "Network analyzer task priority"
	default 100

config APP_NETWORK_STACKSIZE
	int "Network analyzer stack size"
	default 2048

endif
```

## stm32_dds/f410-nsh/defconfig
```kconfig
CONFIG_ADC=y
CONFIG_ANALOG=y
CONFIG_ARCH="arm"
CONFIG_ARCH_BOARD="stm32_dds"
CONFIG_ARCH_BOARD_STM32_DDS=y
CONFIG_ARCH_CHIP_STM32F410RB=y
CONFIG_ARCH_CHIP_STM32=y
CONFIG_ARCH_INTERRUPTSTACK=2048
CONFIG_ARMV7M_STACKCHECK=y
CONFIG_BOARD_INITIALIZE=y
CONFIG_BOARD_LOOPSPERMSEC=8499
CONFIG_BUILTIN=y
CONFIG_DEBUG_ANALOG_ERROR=y
CONFIG_DEBUG_ANALOG_INFO=y
CONFIG_DEBUG_ANALOG_WARN=y
CONFIG_DEBUG_ANALOG=y
CONFIG_DEBUG_ASSERTIONS=y
CONFIG_DEBUG_ERROR=y
CONFIG_DEBUG_FEATURES=y
CONFIG_DEBUG_FULLOPT=y
CONFIG_DEBUG_GPIO_ERROR=y
CONFIG_DEBUG_GPIO_INFO=y
CONFIG_DEBUG_GPIO_WARN=y
CONFIG_DEBUG_GPIO=y
CONFIG_DEBUG_INFO=y
CONFIG_DEBUG_PWM_ERROR=y
CONFIG_DEBUG_PWM_INFO=y
CONFIG_DEBUG_PWM_WARN=y
CONFIG_DEBUG_PWM=y
CONFIG_DEBUG_SPI_ERROR=y
CONFIG_DEBUG_SPI_INFO=y
CONFIG_DEBUG_SPI_WARN=y
CONFIG_DEBUG_SPI=y
CONFIG_DEBUG_SYMBOLS=y
CONFIG_DEBUG_WARN=y
CONFIG_DEFAULT_SMALL=y
# CONFIG_DISABLE_OS_API is not set
CONFIG_DISABLE_POLL=y
# CONFIG_DISABLE_PSEUDOFS_OPERATIONS is not set
CONFIG_EXAMPLES_ADC_SWTRIG=y
CONFIG_EXAMPLES_ADC=y
CONFIG_EXAMPLES_HELLO=y
CONFIG_EXAMPLES_NSH=y
CONFIG_EXAMPLES_PWM=y
CONFIG_FS_PROCFS_REGISTER=y
CONFIG_FS_PROCFS=y
CONFIG_HAVE_CXX=y
CONFIG_HEAP_COLORATION=y
CONFIG_INTELHEX_BINARY=y
CONFIG_LIB_BOARDCTL=y
CONFIG_LIBC_LONG_LONG=y
CONFIG_MAX_TASKS=16
CONFIG_MAX_WDOGPARMS=2
CONFIG_NFILE_DESCRIPTORS=8
CONFIG_NFILE_STREAMS=8
CONFIG_NSH_BUILTIN_APPS=y
# CONFIG_NSH_DISABLE_ADDROUTE is not set
# CONFIG_NSH_DISABLE_BASENAME is not set
# CONFIG_NSH_DISABLEBG is not set
# CONFIG_NSH_DISABLE_CMP is not set
# CONFIG_NSH_DISABLE_DD is not set
# CONFIG_NSH_DISABLE_DELROUTE is not set
# CONFIG_NSH_DISABLE_DF is not set
# CONFIG_NSH_DISABLE_DIRNAME is not set
# CONFIG_NSH_DISABLE_EXEC is not set
# CONFIG_NSH_DISABLE_EXIT is not set
# CONFIG_NSH_DISABLE_GET is not set
# CONFIG_NSH_DISABLE_HEXDUMP is not set
CONFIG_NSH_DISABLE_IFUPDOWN=y
# CONFIG_NSH_DISABLE_ITEF is not set
# CONFIG_NSH_DISABLE_LOOPS is not set
# CONFIG_NSH_DISABLE_LOSETUP is not set
# CONFIG_NSH_DISABLE_MKRD is not set
# CONFIG_NSH_DISABLE_PUT is not set
# CONFIG_NSH_DISABLESCRIPT is not set
# CONFIG_NSH_DISABLE_SEMICOLON is not set
# CONFIG_NSH_DISABLE_TIME is not set
# CONFIG_NSH_DISABLE_UNAME is not set
# CONFIG_NSH_DISABLE_WGET is not set
# CONFIG_NSH_DISABLE_XD is not set
CONFIG_PREALLOC_MQ_MSGS=4
CONFIG_PREALLOC_TIMERS=4
CONFIG_PREALLOC_WDOGS=8
CONFIG_PWM=y
CONFIG_RAMLOG=y
CONFIG_RAM_SIZE=32768
CONFIG_RAM_START=0x20000000
CONFIG_RAW_BINARY=y
CONFIG_RR_INTERVAL=200
CONFIG_SCHED_WAITPID=y
CONFIG_SDCLONE_DISABLE=y
CONFIG_SERIAL_TERMIOS=y
CONFIG_START_DAY=5
CONFIG_START_MONTH=5
CONFIG_START_YEAR=2014
CONFIG_STM32_ADC1=y
CONFIG_STM32_FLASH_CONFIG_B=y
CONFIG_STM32_JTAG_SW_ENABLE=y
CONFIG_STM32_PWR=y
CONFIG_STM32_SPI1=y
CONFIG_STM32_TIM1_PWM=y
CONFIG_STM32_TIM1=y
CONFIG_STM32_USART1=y
CONFIG_SYSTEM_CLE=y
CONFIG_SYSTEM_SUDOKU=y
CONFIG_TASK_NAME_SIZE=0
CONFIG_TIMER=y
CONFIG_USART1_SERIAL_CONSOLE=y
CONFIG_USER_ENTRYPOINT="nsh_main"
CONFIG_WDOG_INTRESERVE=1
```
